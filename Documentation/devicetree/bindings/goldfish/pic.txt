## Documentation/devicetree/bindings/goldfish/pic.txt
```
Android Goldfish PIC

Android goldfish PIC device generated by android emulator.

Required properties:

- compatible : should contain "google,goldfish-pic" to match emulator
- reg        : <registers mapping>
- interrupts : <interrupt mapping>

Example:

	goldfish_pic@9020000 {
		compatible = "google,goldfish-pic";
		reg = <0x9020000 0x1000>;
		interrupts = <0x3>;
	};
```

## Documentation/devicetree/bindings/goldfish/reset.txt
```
Android Goldfish reset

Android goldfish reset device generated by android emulator.

Required properties:

- compatible : should contain "google,goldfishi-reset" to match emulator
- reg        : <registers mapping>
- interrupts : <interrupt mapping>

Example:

	goldfish_reset@9020000 {
		compatible = "google,goldfish-reset";
		reg = <0x9020000 0x1000>;
		interrupts = <0x3>;
	};
```

## Documentation/devicetree/bindings/goldfish/rtc.txt
```
Android Goldfish RTC

Android goldfish RTC device generated by android emulator.

Required properties:

- compatible : should contain "google,goldfish-rtc" to match emulator
- reg        : <registers mapping>
- interrupts : <interrupt mapping>

Example:

	goldfish_rtc@9020000 {
		compatible = "google,goldfish-rtc";
		reg = <0x9020000 0x1000>;
		interrupts = <0x3>;
	};
```

## Documentation/devicetree/bindings/goldfish/timer.txt
```
Android Goldfish timer

Android goldfish timer device generated by android emulator.

Required properties:

- compatible : should contain "google,goldfish-timer" to match emulator
- reg        : <registers mapping>
- interrupts : <interrupt mapping>

Example:

	goldfish_timer@9020000 {
		compatible = "google,goldfish-timer";
		reg = <0x9020000 0x1000>;
		interrupts = <0x3>;
	};
```
